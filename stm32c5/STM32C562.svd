# STM32C562 register map
File version: 1.0.0
CPU: CM33 r0p4, little endian, MPU, FPU, 4 interrupt priority bits
Registers are 32-bit, read-write, reset 0x0 unless marked. A register's access mark holds for its fields unless they carry their own. Offsets are from the block's base; lines under a group give offsets from that group; [hi:lo] are bit positions; {n}, {i} and the like mark numbered series; 'fields as' and 'values as' point back to an identical list; <NAME> marks a mode.

## Memory map
0x40000000 TIM2 size 0x3E4 — TIM address block description
0x40000C00 TIM5 size 0x3E4 — TIM address block description
0x40001000 TIM6 size 0x30 — TIM address block description
0x40001400 TIM7 size 0x30 — TIM address block description
0x40001800 TIM12 size 0x60 — TIM address block description
0x40002C00 WWDG size 0x400 — System window watchdog
0x40003000 IWDG size 0x400 — Independent watchdog
0x40003400 OPAMP1 size 0x400 — Operational amplifiers
0x40003800 SPI2 size 0x400
0x40003C00 SPI3 size 0x400
0x40004000 COMP1 size 0x10 — COMP address block description
0x40004400 USART2 size 0x30
0x40004800 USART3 size 0x30
0x40004C00 UART4 size 0x30
0x40005000 UART5 size 0x30
0x40005400 I2C1 size 0x400 — Inter-integrated circuit
0x40005800 I2C2 size 0x400
0x40005C00 I3C1 size 0x400 — I3C register block
0x40006000 CRS size 0x10 — CRS address block description
0x4000A400 FDCAN1 size 0x400 — Controller area network
0x40012C00 TIM1 size 0x3E4 — TIM address block description
0x40013000 SPI1 size 0x400 — Serial peripheral interface
0x40013400 TIM8 size 0x3E4 — TIM address block description
0x40013800 USART1 size 0x30 — Universal synchronous asynchronous receiver transmitter
0x40014000 TIM15 size 0x3E4 — TIM address block description
0x40014400 TIM16 size 0x3E4 — TIM address block description
0x40014800 TIM17 size 0x3E4 — TIM address block description
0x40016000 USB size 0x400 — USB full speed
0x40020000 LPDMA1 size 0x1000 — LPDMA register block
0x40021000 LPDMA2 size 0x1000 — LPDMA register block
0x40022000 FLASH size 0x200 — FLASH address block description
0x40023000 CRC size 0x400 — Cyclic redundancy check calculation unit
0x40026000 RAMCFG size 0x6C — RAMCFG address block description
0x40030400 ICACHE size 0x400 — ICACHE register block
0x40032400 GTZC1 size 0x800 — Global privilege controller
0x42020000 GPIOA size 0x2C — GPIOA address block description
0x42020400 GPIOB size 0x2C — GPIOB address block description
0x42020800 GPIOC size 0x2C — GPIOC address block description
0x42020C00 GPIOD size 0x2C — GPIOD address block description
0x42021000 GPIOE size 0x2C — GPIOE address block description
0x42021C00 GPIOH size 0x2C — GPIOH address block description
0x42028000 ADC1 size 0x100 — ADC1 register block
0x42028100 ADC2 size 0x100
0x42028300 ADCC12 size 0x14 — ADCC12 address block description
0x42028400 DAC1 size 0x50 — DAC address block description
0x420C0000 AES size 0x400 — AES register block
0x420C0400 HASH size 0x400 — Hash processor
0x420C0800 RNG size 0x400 — RNG register block
0x44000400 SBS size 0x150 — SBS address block description
0x44002400 LPUART size 0x30 — LPUART address block description
0x44004400 LPTIM1 size 0x400 — Low power timer
0x44007800 RTC size 0x400 — RTC register block
0x44007C00 TAMP size 0x400 — TAMP register block
0x44020800 PWR size 0x400 — PWR register block
0x44020C00 RCC size 0x118 — RCC address block description
0x44022000 EXTI size 0x98 — EXTI address block description
0x44024000 DBGMCU size 0x1000 — DBGMCU address block description

## Interrupts
0 WWDG — Window Watchdog interrupt
1 PWR_PVD (PWR) — Power Voltage Monitor
2 RTC — RTC global non-secure interrupts
3 TAMP — Tamper global interrupts
4 RAMCFG — RAM configuration global interrupt
5 FLASH — Flash non-secure global interrupt
6 RCC — RCC non-secure global interrupt
{n+7} EXTI{n} (EXTI) (n=0..15) — EXTI Line{n} interrupt
{n+23} LPDMA1_CH{n} (LPDMA1) (n=0..7) — LPDMA1 channel{n} global interrupt
31 IWDG — IWDG interrupt
32 ADC1 — ADC1 global interrupt
33 ADC2 — ADC2 global interrupt
34 FDCAN1_IT0 (FDCAN1) — FDCAN1 interrupt 0
35 FDCAN1_IT1 (FDCAN1) — FDCAN1 interrupt 1
36 TIM1_BRK_TERR_IERR (TIM1) — TIM1 Break/TIM1 Transition error/TIM1 Index error
37 TIM1_UPD (TIM1) — TIM1 Update
38 TIM1_TRGI_COM_DIR_IDX (TIM1) — TIM1 trigger and commutation/TIM1 Direction Change interrupt/TIM1 Index
39 TIM1_CC (TIM1) — TIM1 capture compare interrupt
40 TIM2 — TIM2 global interrupt
41 TIM5 — TIM5 global interrupt
42 TIM6 — TIM6 global interrupt
43 TIM7 — TIM7 global interrupt
44 I2C1_EV (I2C1) — I2C1 event interrupt
45 I2C1_ERR (I2C1) — I2C1 error interrupt
46 I3C1_EV (I3C1) — I3C1 event interrupt
47 I3C1_ERR (I3C1) — I3C1 error interrupt
48 SPI1 — SPI1 global interrupt
49 SPI2 — SPI2 global interrupt
50 SPI3 — SPI3 global interrupt
51 USART1 — USART1 global interrupt
52 USART2 — USART2 global interrupt
53 USART3 — USART3 global interrupt
54 UART4 — UART4 global interrupt
55 UART5 — UART5 global interrupt
56 LPUART1 (LPUART) — LPUART1 global interrupt
57 LPTIM1 — LPTIM1 global interrupt
58 TIM12 — TIM12 global interrupt
59 TIM15 — TIM15 global interrupt
60 TIM16 — TIM16 global interrupt
61 TIM17 — TIM17 global interrupt
62 USB_DRD_FS (USB) — USB OTG FS global interrupt
63 CRS — Clock Recovery System global interrupt
64 RNG — RNG global interrupt
66 ICACHE — Instruction cache global interrupt
68 AES — AES global interrupt
69 HASH — HASH interrupt
70 I2C2_EV (I2C2) — I2C2 event interrupt
71 I2C2_ERR (I2C2) — I2C2 error interrupt
72 TIM8_BRK_TERR_IERR (TIM8) — TIM8 Break interrupt/TIM8 Transition error/TIM8 Index error
73 TIM8_UPD (TIM8) — TIM8 Update interrupt
74 TIM8_TRGI_COM_DIR_IDX (TIM8) — TIM8 trigger and commutation interrupt/TIM8 Direction Change interrupt/TIM8 Index
75 TIM8_CC (TIM8) — TIM8 capture compare interrupt
76 COMP1 — COMP global interrupt
77 DAC1 — DAC1 global interrupt
78 LPDMA2_CH0 (LPDMA2) — LPDMA2 channel0 global interrupt
79 LPDMA2_CH1 (LPDMA2) — LPDMA2 channel1 global interrupt
80 LPDMA2_CH2 (LPDMA2) — LPDMA2 channel2 global interrupt
81 LPDMA2_CH3 (LPDMA2) — LPDMA2 channe3 global interrupt

## Notices in the file
Copyright (c) 2026 STMicroelectronics.
SPDX-License-Identifier: Apache-2.0
Licensed under the Apache License, Version 2.0 (the "License");
you may not use this file except in compliance with the License.
You may obtain a copy of the License at
http://www.apache.org/licenses/LICENSE-2.0
Unless required by applicable law or agreed to in writing, software
distributed under the License is distributed on an "AS IS" BASIS,
WITHOUT WARRANTIES OR CONDITIONS OF ANY KIND, either express or implied.
See the License for the specific language governing permissions and
limitations under the License.
